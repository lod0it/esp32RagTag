#include <Wire.h>
#include <Adafruit_GFX.h>
#include <Adafruit_SSD1306.h>
#include <Adafruit_BMP280.h>

// --- I2C Split Bus Configuration ---
#define OLED_SDA 8
#define OLED_SCL 9
#define OLED_ADDR 0x3C

#define BMP_SDA 5
#define BMP_SCL 4
#define BMP_ADDR 0x76

#define BTN_PIN 10
#define DEBOUNCE_MS 30
#define REFRESH_MS 500

// --- Variables Init ---
float temp = 0;
float press = 0;
float alt = 0;
uint8_t sensorId = 0;
uint32_t lastRefresh = 0;

// --- Wire Instances ---
Adafruit_SSD1306 display(128, 64, &Wire, -1);
Adafruit_BMP280  bmp;

// -------------------------------------------------------
// SCREEN REGISTRY
// -------------------------------------------------------
void overview();
void temps();
void altitude();
void pressure();

typedef void (*ScreenFunc)();

ScreenFunc screens[] = {
    temps,
    altitude,
    pressure,
    overview,
};

const uint8_t SCREEN_COUNT = sizeof(screens) / sizeof(screens[0]);
uint8_t currentScreen = 0;

// --- Button State ---
bool lastBtnState = HIGH;
bool stableState = HIGH;
uint32_t lastDebounce  = 0;

// -------------------------------------------------------

void setup() {
    Serial.begin(115200);
    delay(1000);
    Serial.println("=== Starting Dual-Bus Sys ===");

    // OLED
    Serial.println("Starting OLED on SDA=8, SCL=9...");
    Wire.begin(OLED_SDA, OLED_SCL, 400000);
    if (!display.begin(SSD1306_SWITCHCAPVCC, OLED_ADDR)) {
        Serial.println("ERROR: OLED not found!");
        while (1);
    }
    Serial.println("OLED Initialized.");

    // BMP280
    Serial.println("Starting BMP280 on SDA=5, SCL=4...");
    Wire1.begin(BMP_SDA, BMP_SCL, 400000);
    if (!bmp.begin(BMP_ADDR)) {
        Serial.println("ERROR: BMP280 not found!");
        Serial.println("check wirings or retry with address 0x77");
        while (1);
    }
    Serial.println("BMP280 OK.");

    // Display splash
    display.clearDisplay();
    display.setTextColor(SSD1306_WHITE);
    display.setTextSize(1);
    display.setCursor(50, 32);
    display.println("READY");
    display.display();
    delay(1000);

    // Button
    pinMode(BTN_PIN, INPUT_PULLUP);
}

void loop() {
        handleButton();

    if (millis() - lastRefresh >= REFRESH_MS) {
        lastRefresh = millis();
        readSensorData();
        screens[currentScreen]();
    }
}

// -------------------------------------------------------
// BUTTON HANDLER  (debounce non-blocking)
// -------------------------------------------------------
void handleButton() {
    bool reading = digitalRead(BTN_PIN);

    if (reading != lastBtnState) {
        lastDebounce = millis();
        lastBtnState = reading;
    }

    if ((millis() - lastDebounce) > DEBOUNCE_MS) {
        if (reading != stableState) {
            stableState = reading;
            if (stableState == LOW) {
                currentScreen = (currentScreen + 1) % SCREEN_COUNT;
                Serial.printf("Screen -> %d / %d\n", currentScreen + 1, SCREEN_COUNT);
            }
        }
    }
}

// -------------------------------------------------------
// SENSORS READINGS
// -------------------------------------------------------
void readSensorData() {
    temp = bmp.readTemperature();
    press = bmp.readPressure() / 100.0;
    alt = abs(bmp.readAltitude());
    sensorId = bmp.sensorID();
}

void printSensorsData() {
    Serial.printf("Temp: %.1f C° | Atmo Pressure: %.0f hPa | Altitude: %.0f Mt\n",
                  temp, press, altitude);
}

// -------------------------------------------------------
// SCREEN WIDGETS
// -------------------------------------------------------
void overview() {
    display.clearDisplay();
    display.fillRect(2, 2, 125, 4, 1);
    display.drawRect(1, 1, 126, 61, 1);
    display.drawLine(47, 2, 47, 61, 1);
    display.drawLine(2, 19, 126, 19, 1);
    display.drawLine(2, 33, 126, 33, 1);
    display.drawLine(2, 47, 126, 47, 1);
    display.setTextColor(1);
    display.setTextSize(1);
    display.setTextWrap(false);
    display.setCursor(6, 9);  display.print("TEMPS");
    display.setCursor(6, 37); display.print("PRESS");
    display.setCursor(6, 23); display.print("ALT");
    display.setCursor(6, 51); display.print("UPTIME");
    display.setCursor(53, 9);  display.printf("%.1f C", temp);
    display.setCursor(53, 23); display.printf("%.0f mt", alt);
    display.setCursor(53, 37); display.printf("%.0f hPa", press);
    display.setCursor(53, 51); display.printf("%lus", millis() / 1000);
    display.display();
}

void temps() {
    
    static const unsigned char PROGMEM image_temps_bits[] = {
    0x00,0x00,0x00,0x00,0x00,0x00,0x00,0x78,0x00,0x00,0x00,0x00,0xfc,0x00,0x00,
    0x00,0x01,0x8e,0x00,0x00,0x00,0x01,0x06,0x00,0x00,0x00,0x03,0x06,0x00,0x00,
    0x00,0x03,0x06,0x78,0x00,0x00,0x03,0x06,0x00,0x00,0x00,0x03,0x06,0x00,0x00,
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    0x00,0x00,0xfc,0x00,0x00,0x00,0x00,0x00,0x00,0x00};
    display.clearDisplay();
    display.fillRect(90, 0, 38, 64, 1);
    display.drawRect(0, 0, 128, 64, 1);
    display.setTextColor(1);
    display.setTextSize(2);
    display.setTextWrap(false);
    display.setCursor(16, 9);
    display.print("TEMPS");
    display.setTextSize(3);
    display.setCursor(10, 35);
    display.printf("%.1f", temp);
    display.setTextColor(0);
    display.setTextSize(2);
    display.setCursor(102, 41);
    display.print("C");
    display.drawBitmap(90, 2, image_temps_bits, 40, 35, 0);
    display.setTextSize(1);
    display.setCursor(114, 36);
    display.print("o");
    display.display();

}

void altitude() {    
    static const unsigned char PROGMEM image_elevIcon_bits[] = {
    0x00,0x00,0x00,0x00,0x00,0x00,0x00,0x00,0x00,0x00,0x00,
    0x00,0x00,0x00,0x00,0x00,0x00,0x00,0x00,0x00,0x00,0x00,
    0x00,0x00,0x00,0x00,0x00,0x00,0x00,0x00,0x00,0x00,0x00,
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    0x00,0x00,0x00,0x00,0x00,0x00,0x00,0x00,0x00};
    display.clearDisplay();
    display.fillRect(90, 0, 38, 64, 1);
    display.drawRect(0, 0, 128, 64, 1);
    display.setTextColor(1);
    display.setTextSize(2);
    display.setTextWrap(false);
    display.setCursor(21, 8);
    display.print("ELEV");
    display.setTextSize(3);
    display.setCursor(10, 35);
    display.printf("%1.f", alt);
    display.setTextColor(0);
    display.setTextSize(2);
    display.setCursor(98, 38);
    display.print("Mt");
    display.drawBitmap(84, -4, image_elevIcon_bits, 48, 40, 0);
    display.display();
}

void pressure() {
    
    static const unsigned char PROGMEM image_baroIcon_bits[] = {
    0x00,0x00,0x00,0x00,0x00,0x00,0x00,0x00,0x00,0x00,0x00,0x00,
    0x00,0x00,0x00,0x00,0x0f,0xf8,0x00,0x00,0x00,0x38,0x06,0x00,
    0x00,0x00,0x67,0xf3,0x1c,0xe0,0x00,0xdf,0xfc,0x80,0x00,0x01,
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    0x00,0x00,0x00,0x00,0x00,0x00,0x00
    };
    display.clearDisplay();
    display.fillRect(90, 0, 38, 64, 1);
    display.drawRect(0, 0, 128, 64, 1);
    display.setTextColor(1);
    display.setTextSize(2);
    display.setTextWrap(false);
    display.setCursor(21, 8);
    display.print("PRES");
    display.setTextSize(3);
    display.setCursor(10, 35);
    display.printf("%.0f", press);
    display.setTextColor(0);
    display.setTextSize(2);
    display.setCursor(92, 38);
    display.print("hPa");
    display.drawBitmap(88, 2, image_baroIcon_bits, 40, 35, 0);
    display.display();
}